## conf/machine/elpaso.conf
```bitbake
#@TYPE: Machine
#@NAME: elpaso
#@DESCRIPTION: Machine configuration for the LSI elpaso systems

PREFERRED_VERSION_linux-yocto ?= "3.4%"
PREFERRED_PROVIDER_virtual/kernel ?= "linux-yocto"

MACHINE_FEATURES += ""

MACHINE_EXTRA_RRECOMMENDS += ""

require conf/machine/include/tune-ppc476.inc

KERNEL_IMAGETYPE = "uImage"
UBOOT_ENTRYPOINT = "0x400000"
KEEPUIMAGE = "no"

SERIAL_CONSOLE = "115200 ttyS0"
```

## conf/machine/lsisim.conf
```bitbake
#@TYPE: Machine
#@NAME: lsisim
#@DESCRIPTION: Machine configuration for LSI simulator systems

PREFERRED_VERSION_linux-yocto ?= "3.4%"
PREFERRED_PROVIDER_virtual/kernel ?= "linux-yocto"

MACHINE_FEATURES += ""

MACHINE_EXTRA_RRECOMMENDS += ""

require conf/machine/include/tune-cortexa15.inc

KERNEL_IMAGETYPE = "uImage"
UBOOT_ENTRYPOINT = "0x400000"
KEEPUIMAGE = "no"

SERIAL_CONSOLE = "9600 ttyS0"
```
